
// Copyright 2026 Rich Heslip
//
// Author: Rich Heslip 
//
// Permission is hereby granted, free of charge, to any person obtaining a copy
// of this software and associated documentation files (the "Software"), to deal
// in the Software without restriction, including without limitation the rights
// to use, copy, modify, merge, publish, distribute, sublicense, and/or sell
// copies of the Software, and to permit persons to whom the Software is
// furnished to do so, subject to the following conditions:
// 
// The above copyright notice and this permission notice shall be included in
// all copies or substantial portions of the Software.
// 
// THE SOFTWARE IS PROVIDED "AS IS", WITHOUT WARRANTY OF ANY KIND, EXPRESS OR
// IMPLIED, INCLUDING BUT NOT LIMITED TO THE WARRANTIES OF MERCHANTABILITY,
// FITNESS FOR A PARTICULAR PURPOSE AND NONINFRINGEMENT. IN NO EVENT SHALL THE
// AUTHORS OR COPYRIGHT HOLDERS BE LIABLE FOR ANY CLAIM, DAMAGES OR OTHER
// LIABILITY, WHETHER IN AN ACTION OF CONTRACT, TORT OR OTHERWISE, ARISING FROM,
// OUT OF OR IN CONNECTION WITH THE SOFTWARE OR THE USE OR OTHER DEALINGS IN
// THE SOFTWARE.
// 
// See http://creativecommons.org/licenses/MIT/ for more information.
//
// -----------------------------------------------------------------------------
//
/*
Granular example for 2HPico DSP hardware 
Granular code generated by ChatGPT and tweeked a bit by me - fun to experiment with!
R Heslip  Feb 2026

**** overclock to 250Mhz - this is quite compute intensive ****

Top Jack - Audio input 

Middle jack - 

Bottom Jack - Left Audio out

First Parameter Page - RED

Top pot - Grain size

Second pot - Grain Density

Third pot - Grain Pitch

Fourth pot - Wet/Dry Mix


*/

#include "2HPico.h"
#include <I2S.h>
#include <Adafruit_NeoPixel.h>
#include <math.h>

#include "pico/multicore.h"
#include "granular.cpp"

#define DEBUG   // comment out to remove debug code
#define MONITOR_CPU1  // define to enable 2nd core monitoring

//#define SAMPLERATE 11025 
#define SAMPLERATE 22050  // about the fastest sampling rate possible at 250Mhz
//#define SAMPLERATE 44100  // 

Adafruit_NeoPixel LEDS(NUMPIXELS, LEDPIN, NEO_GRB + NEO_KHZ800);

I2S i2s(INPUT_PULLUP); // both input and output

Granular granular;

#define CV_VOLT 580.6  // a/d counts per volt - trim for V/octave

#define NUMUISTATES 1 // 
enum UIstates {SET1};
uint8_t UIstate=SET1;

bool button=0;

#define DEBOUNCE 10
#define POTLOCKDELAY 1000 // lock pots if no movement after this in ms - keeps parameters from bouncing around which causes glitches in playback
uint32_t buttontimer,parameterupdate;

#define OUTPUTMAX 0x10010  // a bit more than "1" if DAC range +-32767 is equivalent to +- 0.5
int32_t outputmix=OUTPUTMAX; // mix of normal and aux output

void setup() { 
  Serial.begin(115200);

// set up I/O pins
 
#ifdef MONITOR_CPU1 // for monitoring 2nd core CPU usage
  pinMode(CPU_USE,OUTPUT); // hi = CPU busy
#endif 

  pinMode(BUTTON1,INPUT_PULLUP); // button in
  pinMode(MUXCTL,OUTPUT);  // analog switch mux

  LEDS.begin(); // INITIALIZE NeoPixel strip object (REQUIRED)
  LEDS.setPixelColor(0, RED); 
  LEDS.show();

  analogReadResolution(AD_BITS); // set up for max resolution

// set up I2S for 32 bits in and out
// PCM1808 is 24 bit only but I could not get 24 bit I2S working. 32 bits is little if any extra overhead
  i2s.setDOUT(I2S_DATA);
  i2s.setDIN(I2S_DATAIN);
  i2s.setBCLK(BCLK); // Note: LRCLK = BCLK + 1
  i2s.setMCLK(MCLK);
  i2s.setMCLKmult(256);
  i2s.setBitsPerSample(32);
  i2s.setFrequency(22050);
  i2s.begin();

}


void loop() {

// select UI page - only one page in this app
  if (!digitalRead(BUTTON1)) {
    if (((millis()-buttontimer) > DEBOUNCE) && !button) {  // if button pressed advance to next parameter set
      button=1;  
      ++UIstate;
      if (UIstate >= NUMUISTATES) UIstate=SET1;
      lockpots();
    }
  }
  else {
    buttontimer=millis();
    button=0;
  }

  if ((millis()-parameterupdate) > POTLOCKDELAY) { // lock pots if they are not used for a while - cleaner sound if parameters are stable
    lockpots();
    parameterupdate=millis();
  }
  samplepots();

// assign parameters from panel pots
  switch (UIstate) {
      case SET1:
        LEDS.setPixelColor(0, RED); 
        if (!potlock[0]) granular.setGrainSize(map(pot[0],0,AD_RANGE-1,50, 400)); // 
        if (!potlock[1]) granular.setDensity(map(pot[1],0,AD_RANGE-1,0,100)); 
        if (!potlock[2]) granular.setPitch(mapf(pot[2],0,AD_RANGE-1,0,2.0));
        if (!potlock[3]) outputmix=map(pot[3],0,AD_RANGE-1,OUTPUTMAX,0);
        break;
      default:
        break;
  }

 // LEDS.show();  // update LED
}

// second core setup
// second core is dedicated to sample processing
void setup1() {
delay (1000); // wait for main core to start up peripherals
}

// process audio samples
void loop1(){
  int32_t left,right,mix;
  int16_t out;

// these calls will stall if no data is available
  left=i2s.read();    // input is mono but we still have to read both channels
  right=i2s.read();   // input/output is 32 bits left justified

#ifdef MONITOR_CPU1
  digitalWrite(CPU_USE,1); // hi = CPU busy
#endif

 // granular.process(left>>16, &out);
   out=granular.process(left>>16);

  mix=(left>>16)*outputmix+(int32_t)out*(OUTPUTMAX-outputmix); // mix input and processed signals

#ifdef MONITOR_CPU1  
  digitalWrite(CPU_USE,0); // low - CPU not busy
#endif
// these calls will stall if buffer is full
  i2s.write(mix); // left
	i2s.write(mix); // right

}
